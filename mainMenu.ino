const byte menuMulti[] PROGMEM = {48,40,0xFF,0xFF,0xFF,0xFF,0xFF,0xF0,0x80,0x0,0x0,0x0,0x0,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0xF0,};
const byte menuOption[] PROGMEM = {48,40,0xFF,0xFF,0xFF,0xFF,0xFF,0xF0,0x80,0x0,0x0,0x0,0x0,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0xF0,};
const byte menuSolo[] PROGMEM = {48,40,0xFF,0xFF,0xFF,0xFF,0xFF,0xF0,0x80,0x0,0x0,0x0,0x0,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0xF0,};

byte const * tabSpriteMenu[3] = {menuSolo, menuMulti, menuOption} ;

#define INDEX_MAX_ITEM_MENU 2
byte focusItem;
void initMainMenu()
{
   focusItem = 0;//0 solo game, 1 multi game , 2 option 
}

void updateMainMenu()
{
  if(gb.buttons.pressed(BTN_LEFT))
  {
    if(focusItem == 0)
    {
      focusItem = INDEX_MAX_ITEM_MENU;
    }
    else 
    {
      focusItem--;
    }
  }
  else if(gb.buttons.pressed(BTN_RIGHT))
  {
    if(focusItem == INDEX_MAX_ITEM_MENU)
    {
      focusItem = 0;
    }
    else 
    {
      focusItem++;
    }
  }
  else if(gb.buttons.pressed(BTN_A))
  {
    
    if(focusItem == 1)
    {
      isMaster = false; //TODO Multiplayer game 
      isOnePlayer = false; //TODO Multiplayer game 
      isPaused = true;
      setupMaster();
      setupSlave();
    }
    
    stateGame = focusItem;
  }
}

void drawMainMenu()
{
  gb.display.drawBitmap(-24,8,tabSpriteMenu[((focusItem==0)? INDEX_MAX_ITEM_MENU : focusItem-1)]);
  gb.display.drawBitmap(22,2,tabSpriteMenu[focusItem]);
  gb.display.drawBitmap(68,8,tabSpriteMenu[((focusItem==INDEX_MAX_ITEM_MENU)? 0 : focusItem+1)]);
}
