const byte finalScreen[] PROGMEM = {64,40,0x0,0x0,0x0,0x0,0xC0,0x0,0x40,0x80,0x0,0x0,0x0,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0x0,};
const byte finalScreenLoose[] PROGMEM = {24,5,0x64,0xCC,0xA0,0x8A,0xAA,0xA0,0x4A,0xCC,0x40,0x2A,0xAA,0x40,0xC4,0xAA,0x40,};
const byte finalScreenWin[] PROGMEM = {64,5,0x64,0xA6,0xC4,0xEA,0x84,0xEE,0x4A,0x60,0x8A,0xA8,0xAA,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0xC0,};
const byte finalScreenP1[] PROGMEM = {64,40,0x0,0x0,0x0,0x0,0xC0,0x0,0x40,0x80,0x0,0x0,0x0,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0x0,};

boolean choiceMenu;

void initFinalScreen()
{
  choiceMenu = true;
}

void updateFinalScreen()
{
  if(gb.buttons.pressed(BTN_UP) || gb.buttons.pressed(BTN_DOWN))
  {
    choiceMenu = !choiceMenu;
  }
  if(gb.buttons.pressed(BTN_A))
  {
    initPlayer(true);
    initArena();
    if(choiceMenu)
    {
      if(isOnePlayer) stateGame = 0;
      else stateGame = 1;
    }
    else 
    {
      stateGame = 3;
    }
  }
}

void drawFinalScreen()
{
  if(Player1.cptVictory == 3)
  {
      gb.display.drawBitmap(12,8,finalScreenP1);
  }
  else 
  {
      gb.display.drawBitmap(12,8,finalScreen);
  }

  if(((isMaster|| isOnePlayer ) && Player1.cptVictory == 3) || ( (!isMaster && !isOnePlayer && Player2.cptVictory == 3)))
  {
    gb.display.drawBitmap(10,1,finalScreenWin);
  }
  else 
  {
    gb.display.drawBitmap(10,1,finalScreenLoose);
  }
  gb.display.cursorX = 40;
  if(choiceMenu)
  {
    gb.display.cursorY = 8;
  }
  else 
  {
    gb.display.cursorY = 14;
  }
  gb.display.print(F("\20"));
}
