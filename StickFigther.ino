#include <SPI.h>
#include <Gamebuino.h>
Gamebuino gb;

extern const byte font3x5[]; //a small but efficient font (default)
extern const byte font5x7[]; //a large, comfy font

const byte idle1[] PROGMEM = {8,12,0x78,0x78,0x78,0x20,0x70,0xA8,0xEC,0x20,0x20,0x50,0x48,0x6C,};
const byte idle2[] PROGMEM = {8,12,0x0,0x78,0x78,0x78,0x20,0x70,0xA8,0xEC,0x20,0x50,0x48,0x6C,};
const byte run1[] PROGMEM = {8,12,0x78,0x78,0x78,0x70,0xA8,0xEC,0x20,0x20,0x24,0xDC,0x80,0x0,};
const byte run2[] PROGMEM = {8,12,0x78,0x78,0x78,0x20,0x70,0xA8,0xEC,0x20,0x20,0x20,0x20,0x30,};
const byte kick1[] PROGMEM = {16,12,0x78,0x0,0x78,0x0,0x78,0x0,0x30,0x0,0x7C,0x0,0xA0,0x0,0xE0,0x10,0x20,0xF0,0x3F,0x0,0x40,0x0,0x80,0x0,0xC0,0x0,};
const byte punchLeft1[] PROGMEM = {16,12,0x78,0x0,0x78,0x0,0x78,0x0,0x20,0x0,0x7F,0xF0,0xA0,0x0,0xE0,0x0,0x20,0x0,0x20,0x0,0x50,0x0,0x48,0x0,0x6C,0x0,};
const byte punchRight1[] PROGMEM = {16,12,0x78,0x0,0x78,0x0,0x78,0x0,0x20,0x0,0x60,0x0,0xFF,0x80,0x2C,0x0,0x20,0x0,0x20,0x0,0x50,0x0,0x48,0x0,0x6C,0x0,};
const byte duck1[] PROGMEM = {8,6,0x78,0x78,0x20,0xFC,0x48,0x6C,};
const byte duckKick1[] PROGMEM = {16,6,0x78,0x0,0x78,0x0,0x20,0x0,0xFC,0x0,0x48,0x0,0x47,0xC0,};
const byte jump1[] PROGMEM = {8,12,0x78,0x78,0x78,0x24,0x24,0x78,0xA0,0xA0,0x38,0x44,0x84,0x0,};
const byte jumpKick1[] PROGMEM = {16,12,0x78,0x0,0x78,0x0,0x78,0x0,0x24,0x0,0x24,0x0,0x78,0x0,0xA0,0x0,0xA0,0x0,0x3F,0xE0,0x40,0x0,0x80,0x0,0x0,0x0,};
const byte dead1[] PROGMEM = {16,4,0xE0,0x0,0xE0,0x0,0xEF,0x80,0xFC,0x70,};

const byte fire1[] PROGMEM = {8,13,0x0,0xF0,0xF0,0xF0,0x48,0x78,0x40,0x78,0x48,0x40,0xA0,0xA0,0xF0,};
const byte fireBall1[] PROGMEM = {8,6,0xF8,0x7C,0xCC,0xCC,0x7C,0xF8,};
const byte fireBall2[] PROGMEM = {8,6,0x38,0xC4,0xB4,0xB4,0xC4,0x38,};




typedef struct {
  byte const * sprite1;
  byte const * sprite2;
}animSprite;

#define NB_STATE 10
#define NB_SPRITE_STATE 2
#define TIME_ATTACK 2
#define SPEED_RUN 3
#define GROUND_Y 42

typedef struct {
  uint8_t currentState; // IDL : 0 ,run : 1, kick : 2, punchLeft : 3, punchRight : 4,  duck1 : 5, duck1Kick : 6,jump1 : 7,jumpKick1 : 8 , dead1 : 9
  uint8_t currentSprite;//sprite 1 or 2
  float posX,posY;
  float vx,vy;
  uint8_t height,width;
  animSprite sprites[NB_STATE];
  int8_t life;
  int8_t oldLife;
  int8_t cadance;//speed of change sprite
  int8_t damage; //damage current punch
  byte dir; //NOFLIP -> and FLIPH <-
  int8_t timeAttack,timeNextAttack;
  boolean isJump;
  byte cptVictory;
}
Figther;

Figther Player1 = {0,0,8,29,0,0,13,8,{{idle1,idle2},{run1,run2},{kick1,kick1},{punchLeft1,punchLeft1},{punchRight1,punchRight1},{duck1,duck1},{duckKick1,duckKick1},{jump1,jump1},{jumpKick1,jumpKick1},{dead1,dead1}},100,100,2,5,NOFLIP,4,8,false,0};
Figther Player2 = {0,0,8,29,0,0,13,8,{{idle1,idle2},{run1,run2},{kick1,kick1},{punchLeft1,punchLeft1},{punchRight1,punchRight1},{duck1,duck1},{duckKick1,duckKick1},{jump1,jump1},{jumpKick1,jumpKick1},{dead1,dead1}},100,100,2,5,FLIPH,4,8,false,0};

#define CPT_COMBAT_INIT 30
uint8_t cptCombat = 0;
uint8_t stateFight;

boolean isMaster;
boolean isOnePlayer;


void leftFigther(Figther * player);
void rightFigther(Figther * player);
void highFigther(Figther * player);
void bottomFigther(Figther * player);
void punchFigther(Figther * player);
void kickFigther(Figther * player);
void initPlayer(boolean isStartGame);

//101 starship function
void displayInt(long l, byte Tx, byte Ty, byte fig);


void setup()
{
  gb.begin();
  goTitleScreen();
}

void initGame()
{
  gb.battery.show = false;
  
  isMaster = true; //TODO Multiplayer game 
  isOnePlayer = true; //TODO Multiplayer game 
  initPlayer();
  initArena();
}

void loop(){

 if(gb.update())
 {
    if(gb.buttons.pressed(BTN_C)){
      goTitleScreen();
    }
    updateArena();
    updatePlayer();
    
    drawPlayer();
    drawArena();
   
 }
 // gameOverScreen();
}


void displayInt(uint8_t l, byte Tx, byte Ty, byte fig){
  gb.display.fontSize = 1;
  String sl = String(l);
  while(sl.length() < fig){
    sl = "0" + sl;  
  }
  gb.display.cursorX = Tx;
  gb.display.cursorY = Ty;  
  gb.display.print(sl);
}
